## Firmware/components/LD2410C-UART/Kconfig.projbuild
```kconfig
menu "LD2410C_UART_CONFIG"
    config FOO_ENABLE_BAR_UART
        bool "Enable the BAR UART feature."
        help
            This enables the BAR feature of the FOO component.

    config SENSOR_UART_RX_BUFFER_SIZE
        int "UART RX buffer size"
        default 2048
        help
            UART RX buffer size in bytes
        
    config SENSOR_UART_TX_BUFFER_SIZE
        int "UART TX buffer size"
        default 2048
        help
            UART TX buffer size in bytes

    # config SENSOR_UART_QUEUE_SIZE
    #     int "UART queue size"
    #     default 10
    
        config SENSOR_UART_PORT_NUM
        int "Sensor UART port number"
        range 0 2 if IDF_TARGET_ESP32 || IDF_TARGET_ESP32S3
        default 2 if IDF_TARGET_ESP32 || IDF_TARGET_ESP32S3
        range 0 1
        default 1
        help
            UART communication port number for the LD2410C sensor.

    config SENSOR_UART_RXD
        int "Sensor UART RXD pin number"
        range ENV_GPIO_RANGE_MIN ENV_GPIO_RANGE_MAX
        default 15
        help
            GPIO number for LD2410C UART RX pin. 

    config SENSOR_UART_TXD
        int "Sensor UART TXD pin number"
        range ENV_GPIO_RANGE_MIN ENV_GPIO_RANGE_MAX
        default 14
        help
            GPIO number for LD2410C UART TX pin.

    config SENSOR_UART_INITIAL_BAUD
        int "UART Sensor initial baud_rate"
        default 256000
endmenu
```

## Firmware/main/Kconfig.projbuild
```kconfig
menu "MOTION_MAIN_CONFIG"
    orsource "$IDF_PATH/examples/common_components/env_caps/$IDF_TARGET/Kconfig.env_caps"

    config FOO_ENABLE_BAR
    bool "Enable the BAR feature."
    help
        This enables the BAR feature of the FOO component.


    choice WIFI_PROV_TRANSPORT
        bool "Provisioning Transport"
        default WIFI_PROV_TRANSPORT_SOFTAP if IDF_TARGET_ESP32S2
        default WIFI_PROV_TRANSPORT_BLE
        help
            Wi-Fi provisioning component offers both, SoftAP and BLE transports. Choose any one.

        config WIFI_PROV_TRANSPORT_BLE
            bool "BLE"
            select BT_ENABLED
            depends on !IDF_TARGET_ESP32S2
        config WIFI_PROV_TRANSPORT_SOFTAP
            bool "Soft AP"
            select LWIP_IPV4
    endchoice

    choice WIFI_PROV_SECURITY_VERSION
        bool "Protocomm security version"
        default WIFI_PROV_SECURITY_VERSION_2
        help
            Wi-Fi provisioning component offers 3 security versions.
            The example offers choosing between security version 1 and 2.

        config WIFI_PROV_SECURITY_VERSION_1
            bool "Security version 1"
            select ESP_PROTOCOMM_SUPPORT_SECURITY_VERSION_1

        config WIFI_PROV_SECURITY_VERSION_2
            bool "Security version 2"
            select ESP_PROTOCOMM_SUPPORT_SECURITY_VERSION_2
    endchoice

    choice WIFI_PROV_MODE
        bool "Security version 2 mode"
        depends on WIFI_PROV_SECURITY_VERSION_2
        default WIFI_PROV_SEC2_DEV_MODE

        config WIFI_PROV_SEC2_DEV_MODE
            bool "Security version 2 development mode"
            depends on WIFI_PROV_SECURITY_VERSION_2
            help
                This enables the development mode for
                security version 2.
                Please note that this mode is NOT recommended for production purpose.

        config WIFI_PROV_SEC2_PROD_MODE
            bool "Security version 2 production mode"
            depends on WIFI_PROV_SECURITY_VERSION_2
            help
                This enables the production mode for
                security version 2.
    endchoice

    config WIFI_PROV_TRANSPORT
        int
        default 1 if WIFI_PROV_TRANSPORT_BLE
        default 2 if WIFI_PROV_TRANSPORT_SOFTAP

    config WIFI_PROV_ENABLE_APP_CALLBACK
        bool "Enable provisioning manager app callback"
        default n
        help
            This is for advanced use-cases like modifying Wi-Fi configuration parameters. This
            executes a blocking app callback when any provisioning event is triggered.

    config WIFI_RESET_PROVISIONED
        bool
        default n
        prompt "Reset provisioned status of the device"
        help
            This erases the NVS to reset provisioned status of the device on every reboot.
            Provisioned status is determined by the Wi-Fi STA configuration, saved on the NVS.

    config WIFI_RESET_PROV_MGR_ON_FAILURE
        bool
        default y
        prompt "Reset provisioned credentials and state machine after session failure"
        help
            Enable resetting provisioned credentials and state machine after session failure.
            This will restart the provisioning service after retries are exhausted.

    config WIFI_PROV_MGR_CONNECTION_CNT
        int
        default 5
        prompt "Max connection attempts before resetting provisioning state machine"
        depends on WIFI_RESET_PROV_MGR_ON_FAILURE
        help
            Set the total number of connection attempts to avoid reconnecting to an inexistent AP or if credentials
            are misconfigured. Provisioned credentials are erased and internal state machine
            is reset after this threshold is reached.

    config WIFI_PROV_SHOW_QR
        bool "Show provisioning QR code"
        default y
        help
            Show the QR code for provisioning.

    config WIFI_PROV_USING_BLUEDROID
        bool
        depends on (BT_BLUEDROID_ENABLED && (IDF_TARGET_ESP32C3 || IDF_TARGET_ESP32S3))
        select BT_BLE_42_FEATURES_SUPPORTED
        default y
        help
            This enables BLE 4.2 features for Bluedroid.

    config WIFI_REPROVISIONING
        bool "Re-provisioning"
        help
            Enable re-provisioning - allow the device to provision for new credentials
            after previous successful provisioning.
endmenu
```
